
/**
 * Huawei Ltd.
 * PhosphorV660
 */

/dts-v1/;

/include/ "fastboot.dtsi"
/include/ "PLK_TL00H_VA_config.dtsi"
/include/ "PLK_L01_VA_pin.dtsi"
/include/ "PLK_L01_VA_hi6402_pin.dtsi"
/include/ "PLK_L01_VA_modem_pin.dtsi"
///include/ "PLK_L01_VA_charger.dtsi"
///include/ "PLK_L01_VA_pmic.dtsi"
///include/ "PLK_L01_VA_gpio_logic.dtsi"

/ {
	hisi,boardid = <1 8 0 5 >;
	hisi,boardname = "PLK_L01_VA";
	hisi,modem_id = <0x3EB51580>;

	bcm_wifi {
		wifi_nvram_name = "/vendor/firmware/nvram4339_hw_plk_l01.txt";
	};

	antenna_fpga{
		compatible = "antenna_fpga";
		antenna_fpga,pre-image-filename = "PLK-L01-VA.bin";
		status = "ok";
	};
};

