
/**
 * Huawei Ltd.
 * PhosphorV660
 */

/dts-v1/;

/include/ "fastboot.dtsi"
/include/ "PLK_TL00H_VA_config.dtsi"
/include/ "PLK_UL00_VA_pin.dtsi"
/include/ "PLK_UL00_VA_hi6402_pin.dtsi"
/include/ "PLK_UL00_VA_modem_pin.dtsi"
///include/ "PLK_UL00_VA_charger.dtsi"
///include/ "PLK_UL00_VA_pmic.dtsi"
///include/ "PLK_UL00_VA_gpio_logic.dtsi"

/ {
	hisi,boardid = <1 8 0 2 >;
	hisi,boardname = "PLK_UL00_VA";
	hisi,modem_id = <0x3EB50580>;

	bcm_wifi {
		wifi_nvram_name = "/vendor/firmware/nvram4339_hw_plk_ul00.txt";
	};

	antenna_fpga{
		compatible = "antenna_fpga";
		antenna_fpga,pre-image-filename = "PLK-UL00-VA.bin";
		status = "ok";
	};
};

