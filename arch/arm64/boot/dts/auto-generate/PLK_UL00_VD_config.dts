
/**
 * Huawei Ltd.
 * PhosphorV660
 */

/dts-v1/;

/include/ "fastboot.dtsi"
/include/ "PLK_TL00_VC_config.dtsi"
/include/ "PLK_UL00_VD_pin.dtsi"
/include/ "PLK_UL00_VD_hi6402_pin.dtsi"
/include/ "PLK_UL00_VD_modem_pin.dtsi"
///include/ "PLK_UL00_VD_charger.dtsi"
///include/ "PLK_UL00_VD_pmic.dtsi"
///include/ "PLK_UL00_VD_gpio_logic.dtsi"

/ {
	hisi,boardid = <1 8 8 5 >;
	hisi,boardname = "PLK_UL00_VD";
	hisi,modem_id = <0x3EB53580>;
	hisi,sub_platform_info0 = "Kirin935";

	target-cpu {
		compatible = "hisi,targetcpu";
		target_cpu = "Kirin 935";
	};

	antenna_fpga{
		compatible = "antenna_fpga";
		antenna_fpga,pre-image-filename = "PLK-UL00-VA.bin";
		status = "ok";
	};
};


