
/**
 * Huawei Ltd.
 * PhosphorV660
 */


/include/ "fastboot.dtsi"
/include/ "PLK_UL00_VD_config.dtsi"
/include/ "PLK_UL00_VE_pin.dtsi"
/include/ "PLK_UL00_VE_hi6402_pin.dtsi"
/include/ "PLK_UL00_VE_modem_pin.dtsi"
///include/ "PLK_UL00_VE_charger.dtsi"
///include/ "PLK_UL00_VE_pmic.dtsi"
///include/ "PLK_UL00_VE_gpio_logic.dtsi"

/ {
	hisi,boardid = <1 8 9 9 >;
	hisi,boardname = "PLK_UL00_VE";
	hisi,modem_id = <0x3EB55580>;
};


